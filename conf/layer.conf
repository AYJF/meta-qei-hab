## conf/layer.conf
```bitbake
# We have a conf and classes directory, add to BBPATH
BBPATH .= ":${LAYERDIR}"

# We have recipes-* directories, add to BBFILES
BBFILES += "${LAYERDIR}/recipes-*/*/*.bb \
            ${LAYERDIR}/recipes-*/*/*.bbappend"

BBFILE_COLLECTIONS += "meta-qei-hab"
BBFILE_PATTERN_meta-qei-hab = "^${LAYERDIR}/"
BBFILE_PRIORITY_meta-qei-hab = "10"

LAYERSERIES_COMPAT_meta-qei-hab = "kirkstone"
```
